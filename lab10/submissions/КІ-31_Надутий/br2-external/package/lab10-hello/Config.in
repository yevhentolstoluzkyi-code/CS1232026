## lab10/submissions/КІ-31_Надутий/br2-external/package/lab10-hello/Config.in
```kconfig
config BR2_PACKAGE_LAB10_HELLO
	bool "lab10-hello"
	depends on BR2_LINUX_KERNEL
	help
	  Minimal out-of-tree Linux kernel module for LAB10.
	  Built against the kernel of the target image.

comment "lab10-hello needs a Linux kernel to be built"
	depends on !BR2_LINUX_KERNEL
```

## lab11/submissions/КІ-31_Надутий/br2-external/Config.in
```kconfig
source "$BR2_EXTERNAL_LAB11_PATH/package/lab11-opencount/Config.in"
source "$BR2_EXTERNAL_LAB11_PATH/package/lab11-bpf/Config.in"
```

## lab11/submissions/КІ-31_Надутий/br2-external/configs/lab11_qemu_x86_64_defconfig
```kconfig
BR2_x86_64=y
BR2_TOOLCHAIN_EXTERNAL=y
BR2_TOOLCHAIN_EXTERNAL_BOOTLIN_X86_64_GLIBC_STABLE=y
BR2_GLOBAL_PATCH_DIR="board/qemu/patches"
BR2_DOWNLOAD_FORCE_CHECK_HASHES=y
BR2_TARGET_GENERIC_HOSTNAME="lab11-shevchenko"
BR2_TARGET_GENERIC_ISSUE="Welcome to LAB11 (KI-31_Shevchenko)"
BR2_SYSTEM_DHCP="eth0"
BR2_ROOTFS_OVERLAY="$(BR2_EXTERNAL_LAB11_PATH)/board/lab11/rootfs-overlay"
BR2_ROOTFS_POST_IMAGE_SCRIPT="$(BR2_EXTERNAL_LAB11_PATH)/board/lab11/post-image.sh"
BR2_LINUX_KERNEL=y
BR2_LINUX_KERNEL_CUSTOM_VERSION=y
BR2_LINUX_KERNEL_CUSTOM_VERSION_VALUE="6.18.7"
BR2_LINUX_KERNEL_USE_CUSTOM_CONFIG=y
BR2_LINUX_KERNEL_CUSTOM_CONFIG_FILE="board/qemu/x86_64/linux.config"
BR2_LINUX_KERNEL_CONFIG_FRAGMENT_FILES="$(BR2_EXTERNAL_LAB11_PATH)/board/lab11/linux.fragment"
BR2_LINUX_KERNEL_NEEDS_HOST_LIBELF=y
BR2_PACKAGE_BPFTOOL=y
BR2_PACKAGE_DROPBEAR=y
BR2_TARGET_ROOTFS_EXT2=y
# BR2_TARGET_ROOTFS_TAR is not set
BR2_PACKAGE_LAB11_OPENCOUNT=y
BR2_PACKAGE_LAB11_BPF=y
```

## lab11/submissions/КІ-31_Надутий/br2-external/package/lab11-bpf/Config.in
```kconfig
config BR2_PACKAGE_LAB11_BPF
	bool "lab11-bpf"
	depends on BR2_TOOLCHAIN_HAS_SYNC_4 # libbpf
	depends on BR2_USE_WCHAR # libbpf
	depends on !BR2_STATIC_LIBS # libbpf
	depends on BR2_TOOLCHAIN_HAS_THREADS # libbpf
	depends on BR2_TOOLCHAIN_HEADERS_AT_LEAST_4_13 # libbpf
	select BR2_PACKAGE_LIBBPF
	help
	  LAB11 eBPF tools: opencount (loader for the opencount.bpf.o
	  tracepoint program), openbench (cost of one openat) and
	  three programs that the BPF verifier must reject.

	  The BPF objects are compiled with clang from the build
	  machine: install it with your distribution (apt install
	  clang).

comment "lab11-bpf needs a toolchain w/ wchar, dynamic library, threads, headers >= 4.13"
	depends on BR2_TOOLCHAIN_HAS_SYNC_4
	depends on !BR2_USE_WCHAR || BR2_STATIC_LIBS \
		|| !BR2_TOOLCHAIN_HAS_THREADS \
		|| !BR2_TOOLCHAIN_HEADERS_AT_LEAST_4_13
```

## lab11/submissions/КІ-31_Надутий/br2-external/package/lab11-opencount/Config.in
```kconfig
config BR2_PACKAGE_LAB11_OPENCOUNT
	bool "lab11-opencount"
	depends on BR2_LINUX_KERNEL
	help
	  LAB11 kernel modules: lab11_opencount counts openat() calls
	  through the sys_enter tracepoint; lab11_oops shows what a
	  bug in a kernel module does to the system.

comment "lab11-opencount needs a Linux kernel to be built"
	depends on !BR2_LINUX_KERNEL
```

## lab10/starter/br2-external/Config.in
```kconfig
source "$BR2_EXTERNAL_LAB10_PATH/package/lab10-sysinfo/Config.in"
source "$BR2_EXTERNAL_LAB10_PATH/package/lab10-hello/Config.in"
```

## lab10/starter/br2-external/package/lab10-sysinfo/Config.in
```kconfig
config BR2_PACKAGE_LAB10_SYSINFO
	bool "lab10-sysinfo"
	help
	  Prints a short report about the running system: kernel,
	  C library, uptime, memory, processes and loaded kernel
	  modules. Used to check the LAB10 image.
```
